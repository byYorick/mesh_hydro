## node_climate/sdkconfig.defaults
```kconfig
# NODE Climate Configuration

# ESP32 Target (стандартный ESP32, не S3)
CONFIG_IDF_TARGET="esp32"

# ESP-WIFI-MESH (NODE режим)
CONFIG_ESP_WIFI_MESH_SUPPORT=y

# FreeRTOS
CONFIG_FREERTOS_HZ=1000
CONFIG_ESP_TASK_WDT=y
CONFIG_ESP_TASK_WDT_TIMEOUT_S=10

# Memory
CONFIG_ESP_SYSTEM_EVENT_TASK_STACK_SIZE=4096
CONFIG_MAIN_TASK_STACK_SIZE=6144

# I2C для датчиков
CONFIG_I2C_ENABLE=y

# Logging
CONFIG_LOG_DEFAULT_LEVEL_INFO=y
CONFIG_LOG_MAXIMUM_LEVEL_VERBOSE=y
CONFIG_LOG_COLORS=y

# Flash size
CONFIG_ESPTOOLPY_FLASHSIZE_4MB=y

# Custom partition table (увеличенный app раздел 1.5MB)
CONFIG_PARTITION_TABLE_CUSTOM=y
CONFIG_PARTITION_TABLE_CUSTOM_FILENAME="partitions.csv"
CONFIG_PARTITION_TABLE_FILENAME="partitions.csv"
```

## node_display/sdkconfig.defaults
```kconfig
# ════════════════════════════════════════════════════════
# NODE DISPLAY - ESP32-S3 Configuration (с PSRAM!)
# ════════════════════════════════════════════════════════

# Target
CONFIG_IDF_TARGET="esp32s3"

# PSRAM (ОБЯЗАТЕЛЬНО для LVGL!)
CONFIG_SPIRAM=y
CONFIG_SPIRAM_MODE_OCT=y
CONFIG_SPIRAM_SPEED_80M=y
CONFIG_SPIRAM_USE_MALLOC=y
CONFIG_SPIRAM_MALLOC_ALWAYSINTERNAL=16384
CONFIG_SPIRAM_TRY_ALLOCATE_WIFI_LWIP=y

# Mesh
CONFIG_ESP_WIFI_MESH_SUPPORT=y

# WiFi
CONFIG_ESP_WIFI_STATIC_RX_BUFFER_NUM=16
CONFIG_ESP_WIFI_DYNAMIC_RX_BUFFER_NUM=32
CONFIG_ESP_WIFI_TX_BUFFER_TYPE=1
CONFIG_ESP_WIFI_DYNAMIC_TX_BUFFER_NUM=32
CONFIG_ESP_WIFI_AMPDU_TX_ENABLED=n
CONFIG_ESP_WIFI_AMPDU_RX_ENABLED=n

# FreeRTOS
CONFIG_FREERTOS_HZ=1000
CONFIG_FREERTOS_UNICORE=n

# Log
CONFIG_LOG_DEFAULT_LEVEL_INFO=y
CONFIG_LOG_DEFAULT_LEVEL=3

# Main task
CONFIG_ESP_MAIN_TASK_STACK_SIZE=8192

# Watchdog - отключён для отладки
CONFIG_ESP_TASK_WDT=n

# ESP32-S3 specific
CONFIG_ESP32S3_DEFAULT_CPU_FREQ_240=y

# SPI Flash
CONFIG_ESPTOOLPY_FLASHSIZE_4MB=y
CONFIG_ESPTOOLPY_FLASHMODE_DIO=y
CONFIG_ESPTOOLPY_FLASHFREQ_80M=y
```

## node_ph/sdkconfig.defaults
```kconfig
# NODE pH - ESP32-C3 Configuration

# Target ESP32-C3
CONFIG_IDF_TARGET="esp32c3"

# WiFi Configuration (ВАЖНО: должно совпадать с ROOT node!)
CONFIG_ESP_WIFI_SSID="your_wifi_ssid"
CONFIG_ESP_WIFI_PASSWORD="your_wifi_password"

# Mesh Configuration
CONFIG_ESP_WIFI_CHANNEL=6
CONFIG_ESP_MAX_STA_CONN=6

# Optimization
CONFIG_COMPILER_OPTIMIZATION_SIZE=y
CONFIG_COMPILER_OPTIMIZATION_ASSERTIONS_SILENT=y

# FreeRTOS
CONFIG_FREERTOS_HZ=1000
CONFIG_FREERTOS_UNICORE=y

# ESP System
CONFIG_ESP_SYSTEM_EVENT_TASK_STACK_SIZE=4096
CONFIG_ESP_MAIN_TASK_STACK_SIZE=8192

# Logging
CONFIG_LOG_DEFAULT_LEVEL_INFO=y
CONFIG_LOG_MAXIMUM_LEVEL_VERBOSE=y

# Partition Table
CONFIG_PARTITION_TABLE_CUSTOM=y
CONFIG_PARTITION_TABLE_CUSTOM_FILENAME="partitions.csv"
CONFIG_PARTITION_TABLE_FILENAME="partitions.csv"

# Flash size
CONFIG_ESPTOOLPY_FLASHSIZE_4MB=y

# I2C
CONFIG_I2C_ENABLE_DEBUG_LOG=n

# Mesh
CONFIG_ESP_WIFI_MESH_MAX_LAYER=6
```

## node_ph_ec/sdkconfig.defaults
```kconfig
# ════════════════════════════════════════════════════════
# NODE pH/EC - ESP32-S3 Configuration
# ════════════════════════════════════════════════════════

# Target
CONFIG_IDF_TARGET="esp32s3"

# Mesh
CONFIG_ESP_WIFI_MESH_SUPPORT=y

# WiFi
CONFIG_ESP_WIFI_STATIC_RX_BUFFER_NUM=16
CONFIG_ESP_WIFI_DYNAMIC_RX_BUFFER_NUM=32
CONFIG_ESP_WIFI_TX_BUFFER_TYPE=1
CONFIG_ESP_WIFI_DYNAMIC_TX_BUFFER_NUM=32
CONFIG_ESP_WIFI_AMPDU_TX_ENABLED=n
CONFIG_ESP_WIFI_AMPDU_RX_ENABLED=n

# FreeRTOS
CONFIG_FREERTOS_HZ=1000
CONFIG_FREERTOS_UNICORE=n

# Log
CONFIG_LOG_DEFAULT_LEVEL_INFO=y
CONFIG_LOG_DEFAULT_LEVEL=3

# Main task
CONFIG_ESP_MAIN_TASK_STACK_SIZE=8192

# Watchdog - ОТКЛЮЧЁН для отладки
CONFIG_ESP_TASK_WDT=n

# ESP32-S3 specific
CONFIG_ESP32S3_DEFAULT_CPU_FREQ_240=y

# Partition table
CONFIG_PARTITION_TABLE_CUSTOM=y
CONFIG_PARTITION_TABLE_CUSTOM_FILENAME="partitions.csv"
```

## root_node/main/Kconfig.projbuild
```kconfig
menu "ROOT Node WiFi Configuration"

    config WIFI_SSID
        string "WiFi SSID"
        default "Yorick"
        help
            SSID (network name) for the WiFi router to connect to.

    config WIFI_PASSWORD
        string "WiFi Password"
        default "pro100parol"
        help
            WiFi password (WPA or WPA2) for the router.

endmenu
```

## root_node/sdkconfig.defaults
```kconfig
# ROOT NODE Configuration

# ESP32-S3 Target
CONFIG_IDF_TARGET="esp32s3"

# WiFi Configuration
CONFIG_WIFI_SSID="Yorick"
CONFIG_WIFI_PASSWORD="pro100password"

# ESP-WIFI-MESH
CONFIG_ESP_WIFI_MESH_SUPPORT=y

# MQTT Configuration  
CONFIG_MQTT_PROTOCOL_311=y
CONFIG_MQTT_TRANSPORT_SSL=n
CONFIG_MQTT_TRANSPORT_WEBSOCKET=n

# FreeRTOS
CONFIG_FREERTOS_HZ=1000
CONFIG_FREERTOS_UNICORE=n
CONFIG_ESP_TASK_WDT=y
CONFIG_ESP_TASK_WDT_TIMEOUT_S=10

# Memory
CONFIG_ESP_SYSTEM_EVENT_TASK_STACK_SIZE=4096
CONFIG_MAIN_TASK_STACK_SIZE=8192

# Logging
CONFIG_LOG_DEFAULT_LEVEL_INFO=y
CONFIG_LOG_MAXIMUM_LEVEL_VERBOSE=y
CONFIG_LOG_COLORS=y

# Flash size
CONFIG_ESPTOOLPY_FLASHSIZE_4MB=y

# Partition table
CONFIG_PARTITION_TABLE_CUSTOM=y
CONFIG_PARTITION_TABLE_CUSTOM_FILENAME="partitions.csv"
```
